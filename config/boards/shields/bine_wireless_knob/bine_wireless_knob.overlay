/ {
    chosen {
        zmk,kscan = &kscan0;
    };

    kscan0: kscan {
        compatible = "zmk,kscan-gpio-direct";

        label = "KSCAN";

        input-gpios
            = <&pro_micro B4 (GPIO_ACTIVE_LOW | GPIO_PULL_UP)>
            ;

    };

};